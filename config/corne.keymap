#define CONFIG_WIRELESS
#define ZMK_BASE_LAYER(name, LT, RT, LM, RM, LB, RB, LH, RH)                   \
    ZMK_LAYER(                                                                 \
        name,                                                                  \
        &none     LT RT   &none                                                       \
        &none     LM RM   &none                                                       \
        &none     LB RB   &none                                                       \
        &none &kp LGUI LH RH &smart_mouse &none                                \
    )

#include "zmk-helpers/key-labels/42.h"
#include "base.keymap"
